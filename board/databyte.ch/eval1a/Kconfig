## board/databyte.ch/eval1a/Kconfig
```kconfig
if TARGET_EVAL1A

config SYS_BOARD
	default "eval1a"

config SYS_VENDOR
	default "databyte.ch"

config SYS_CONFIG_NAME
	default "eval1a"

endif
```

## configs/eval1a_defconfig
```kconfig
CONFIG_ARM=y
CONFIG_ARCH_MX6=y
CONFIG_TARGET_EVAL1A=y
CONFIG_SYS_EXTRA_OPTIONS="IMX_CONFIG=board/databyte.ch/eval1a/imximage.cfg,MX6ULL,DDR_MB=256"
#CONFIG_DEFAULT_DEVICE_TREE="eval1a"
CONFIG_MXC_UART=y
CONFIG_DM_MMC=y
CONFIG_CMD_FAT=y
CONFIG_CMD_CACHE=y
CONFIG_CMD_EXT2=y
CONFIG_CMD_EXT4=y
CONFIG_CMD_EXT4_WRITE=y
CONFIG_CMD_FS_GENERIC=y
CONFIG_CMD_MMC=y
CONFIG_CMD_DHCP=y
CONFIG_CMD_PING=y
CONFIG_FSL_ESDHC=y
CONFIG_CMD_BMODE=y
CONFIG_CMD_BOOTZ=y
CONFIG_OF_LIBFDT=y
CONFIG_USE_IMXIMG_PLUGIN=y

#CONFIG_SPL_TEXT_BASE=0x00907000
#CONFIG_SPL_BUILD=y
#CONFIG_SPL_IMAGE="spl/u-boot-spl.bin"
CONFIG_PINCTRL=y
CONFIG_PINCTRL_IMX6=y
CONFIG_DM_GPIO=y
CONFIG_CMD_GPIO=y
CONFIG_FEC_MXC=y
CONFIG_CMD_MII=y
CONFIG_PHYLIB=y
CONFIG_MII=y
CONFIG_DM_ETH=y
CONFIG_ETH=y
CONFIG_PHY_MICREL=y
CONFIG_PHY_MICREL_KSZ8XXX=y
CONFIG_RMII=y
CONFIG_NET_RANDOM_ETHADDR=y

CONFIG_DEFAULT_DEVICE_TREE="eval1a"

CONFIG_NR_DRAM_BANKS=1

CONFIG_SYS_TEXT_BASE=0x87800000
```
